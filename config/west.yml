## config/west.yml
```yaml
manifest:
  remotes:
    - name: zmkfirmware
      url-base: https://github.com/zmkfirmware
    - name: kumamuk-git
      url-base: https://github.com/kumamuk-git
  projects:
    - name: zmk
      remote: zmkfirmware
      revision: main
      import: app/west.yml
    - name: zmk-pmw3610-driver
      remote: kumamuk-git
      revision: main
    - name: zmk-config-roBa
      remote: kumamuk-git
      revision: main
      path: config/boards/shields
      # sha: latest  # shaの行を削除または動的に設定する
  self:
    path: config
```
